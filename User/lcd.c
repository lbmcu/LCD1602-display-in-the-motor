#include "lcd.h"

/********************************************************************
* 名称 : bit Busy(void)
* 功能 : 这个是一个读状态函数，读出函数是否处在忙状态
* 输入 : 输入的命令值
* 输出 : 无
***********************************************************************/
bit Busy(void)
{
    bit busy_flag = 0;
    RS = 0;
    RW = 1;
    E = 1;
    delay3();
    busy_flag = (bit)(P0 & 0x80);
    E = 0;
    return busy_flag;
}
/********************************************************************
* 名称 : wcmd(uchar del)
* 功能 : 1602命令函数
* 输入 : 输入的命令值
* 输出 : 无
***********************************************************************/
void wcmd(uchar del)
{
    while(Busy());
    RS = 0;
    RW = 0;
    E = 0;
    delay3();
    P0 = del;
    delay3();
    E = 1;
    delay3();
    E = 0;
}

/********************************************************************
* 名称 : wdata(uchar del)
* 功能 : 1602写数据函数
* 输入 : 需要写入1602的数据
* 输出 : 无
***********************************************************************/

void wdata(uchar del)
{
    while(Busy());
    RS = 1;
    RW = 0;
    E = 0;
    delay3();
    P0 = del;
    delay3();
    E = 1;
    delay3();
    E = 0;
}

/********************************************************************
* 名称 : L1602_init()
* 功能 : 1602初始化，请参考1602的资料
* 输入 : 无
* 输出 : 无
***********************************************************************/
void L1602_init(void)
{
    wcmd(0x38);
    Delay(5);
    wcmd(0x38);
    Delay(5);
    wcmd(0x38);
    Delay(5);
    wcmd(0x38);
    wcmd(0x08);
    wcmd(0x0c);
    wcmd(0x04);
    wcmd(0x01);
}


//不用注释掉，防止报错未调用该函数
///********************************************************************
//* 名称 : L1602_char(uchar hang,uchar lie,char sign)
//* 功能 : 改变液晶中某位的值，如果要让第一行，第五个字符显示"b" ，调用该函数如下
//		 L1602_char(1,5,'b')
//* 输入 : 行，列，需要输入1602的数据
//* 输出 : 无
//***********************************************************************/
//void L1602_char(uchar hang, uchar lie, char sign)
//{
//    uchar a;
//    if(hang == 1) a = 0x80;
//    if(hang == 2) a = 0xc0;
//    a = a + lie - 1;
//    wcmd(a);
//    wdata(sign);
//}

/********************************************************************
* 名称 : L1602_string(uchar hang,uchar lie,uchar *p)
* 功能 : 改变液晶中某位的值，如果要让第一行，第五个字符开始显示"ab cd ef" ，调用该函数如下
	 	 L1602_string(1,5,"ab cd ef;")
* 输入 : 行，列，需要输入1602的数据
* 输出 : 无
***********************************************************************/
void L1602_string(uchar hang, uchar lie, uchar *p)
{
    uchar a, b = 0;
    if(hang == 1) a = 0x80;
    if(hang == 2) a = 0xc0;
    a = a + lie - 1;
    while(1)
    {
        wcmd(a++);
        if((*p == '\0') || (b == 16)) break;
        b++;
        wdata(*p);
        p++;
    }
}

/**
*	名称 ：LCD_display(uchar *p,uchar *q)
* 功能 ；屏幕通过指针调用主函数的然后根据串口的输入去判断q的选择
**/
void LCD_display(uchar *p,uchar *q)
{
//	  L1602_init();
//    Delay(100);
    P2 = 0x00;
		L1602_string(1, 1, p);
		L1602_string(2,1, q);
}